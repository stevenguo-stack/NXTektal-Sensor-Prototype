#pragma once
#include <Arduino.h>
#include "HT_st7735.h"
#include <string.h>

// NXTektal Display V3: Heltec Wireless Tracker (160x80 ST7735).
// Brand mark sourced from matthewong1210/nxtektal-website/public/brand/nx-mark.png.
// 5s animation: no repeated full-screen clears. TX/RX use identical alarm colors.
namespace NXTUI {

static HT_st7735 display;
static constexpr uint32_t SPLASH_MS = 5000;
static constexpr uint16_t BLACK = ST7735_BLACK;
static constexpr uint16_t WHITE = ST7735_WHITE;
static constexpr uint16_t GREEN = ST7735_COLOR565(110, 243, 18);
static constexpr uint16_t DEEP_GREEN = ST7735_COLOR565(0, 28, 3);
static constexpr uint16_t YELLOW = ST7735_COLOR565(255, 206, 32);
static constexpr uint16_t DEEP_YELLOW = ST7735_COLOR565(48, 31, 0);
static constexpr uint16_t RED = ST7735_COLOR565(255, 85, 82);
static constexpr uint16_t DEEP_RED = ST7735_COLOR565(48, 9, 8);
static constexpr uint16_t GREY = ST7735_COLOR565(160, 170, 167);
static constexpr uint16_t DIM = ST7735_COLOR565(64, 77, 74);
static constexpr int LOGO_W = 50;
static constexpr int LOGO_H = 24;

// A 16-shade packed 4-bpp thumbnail of the official NX mark (50x24).
static const uint16_t logoPalette[16] PROGMEM = {
0x0000, 0x00A0, 0x0120, 0x0980, 0x0A00, 0x0AC0, 0x2AC0, 0x1BE0, 0x2C20, 0x3CC0, 0x4520, 0x5580, 0x5DE0, 0x6E60, 0x7EE0, 0x97A0
};
static const uint8_t logo4bpp[600] PROGMEM = {
  0x00, 0x00, 0x00, 0x00, 0x00, 0x00, 0x00, 0x00, 0x00, 0x00, 0x00, 0x00, 0x13, 0x43, 0x00, 0x00,
  0x00, 0x00, 0x00, 0x00, 0x36, 0x66, 0x66, 0x66, 0x63, 0x00, 0x00, 0x00, 0x00, 0x00, 0x00, 0x00,
  0x00, 0x00, 0x00, 0x00, 0x28, 0xBB, 0xBC, 0xB6, 0x00, 0x00, 0x00, 0x00, 0x06, 0xFF, 0xFF, 0xFF,
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  0x00, 0x00, 0x16, 0x66, 0x68, 0x88, 0x88, 0x10
};

// This driver transfers draw_image() in raw MSB-first byte order. Convert
// native RGB565 to byte-swapped uint16_t memory once when drawing the mark.
static uint16_t logoFrame[LOGO_W * LOGO_H];
static uint32_t bootAt = 0;
static uint32_t lastBootProgress = 0;
static bool brandDrawn = false;
static bool markDrawn = false, subtitleDrawn = false, statusMode = false;
static bool statusBase = false, statusIsTx = false;
static int cachedDistance = -32768;
static int cachedRssi = 32767, cachedSnr = 32767;
static unsigned long cachedSeq = 0xFFFFFFFFUL;
static bool cachedLink = false, cachedFooterLink = false;
static char cachedLevel[22] = "";

inline void drawMarkOnce() {
  for (int i = 0; i < LOGO_W * LOGO_H; ++i) {
    const uint8_t packed = pgm_read_byte(&logo4bpp[i >> 1]);
    const uint8_t paletteIndex = (i & 1) ? (packed & 0xF) : (packed >> 4);
    const uint16_t native = pgm_read_word(&logoPalette[paletteIndex]);
    logoFrame[i] = (native >> 8) | (native << 8);
  }
  display.st7735_draw_image(6, 21, LOGO_W, LOGO_H, logoFrame);
}

// v5: true italic NXTektal wordmark, green (only the startup name changes).
// Rasterized into 4-bit antialiasing for stable ST7735 output; font file not required.
static constexpr int WORD_W = 95;
static constexpr int WORD_H = 21;
static const uint8_t wordmark4bpp[(WORD_W*WORD_H+1)/2] PROGMEM = {
  0x00, 0x00, 0x00, 0x00, 0x00, 0x00, 0x00, 0x00, 0x00, 0x00, 0x00, 0x00, 0x00, 0x00, 0x00, 0x00,
  0x00, 0x00, 0x00, 0x00, 0x00, 0x00, 0x00, 0x00, 0x00, 0x00, 0x00, 0x00, 0x00, 0x00, 0x00, 0x00,
  0x00, 0x00, 0x00, 0x00, 0x00, 0x00, 0x00, 0x00, 0x00, 0x00, 0x00, 0x00, 0x00, 0x00, 0x00, 0x00,
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  0x00, 0x00, 0x00, 0x00, 0x00, 0x00
};
static const uint16_t wordmarkPalette[16] PROGMEM = {
  0x0000, 0x0080, 0x0900, 0x1180, 0x1A00, 0x2280, 0x2B00, 0x3381,
  0x3C01, 0x4481, 0x4D01, 0x5581, 0x5E01, 0x5E82, 0x6702, 0x6F82
};
static uint16_t wordmarkFrame[WORD_W * WORD_H];

inline void drawBrandNameOnce() {
  for (int i = 0; i < WORD_W * WORD_H; ++i) {
    uint8_t packed = pgm_read_byte(&wordmark4bpp[i >> 1]);
    uint8_t index = (i & 1) ? (packed & 0x0F) : (packed >> 4);
    uint16_t rgb565 = pgm_read_word(&wordmarkPalette[index]);
    // HT_st7735::st7735_draw_image() writes raw bytes in memory order.
    wordmarkFrame[i] = (rgb565 >> 8) | (rgb565 << 8);
  }
  display.st7735_draw_image(61, 23, WORD_W, WORD_H, wordmarkFrame);
}

inline void begin() {
  display.st7735_init();
  display.st7735_fill_screen(BLACK);  // Only initial clear.
  display.st7735_fill_rectangle(8, 69, 144, 3, DIM);
  bootAt = millis();
  lastBootProgress = 0;
  brandDrawn = false;
  markDrawn = false;
  subtitleDrawn = false;
  statusMode = false;
  statusBase = false;
}

inline bool tick() {
  if (statusMode) return true;
  const uint32_t elapsed = millis() - bootAt;
  if (elapsed >= SPLASH_MS) {
    display.st7735_fill_screen(BLACK);   // One clear at page transition.
    statusMode = true;
    statusBase = false;
    return true;
  }
  if (elapsed >= 300 && !markDrawn) {
    drawMarkOnce();
    markDrawn = true;
  }
  // Draw the name once, clearly and reliably, next to the logo.
  if (elapsed >= 650 && !brandDrawn) {
    drawBrandNameOnce();
    brandDrawn = true;
  }
  if (elapsed >= 1950 && !subtitleDrawn) {
    display.st7735_write_str(10, 54, "BALL LEVEL TELEMETRY", Font_7x10,
                              GREY, BLACK);
    subtitleDrawn = true;
  }
  // Progress bar draws only new pixels, never redraws the screen.
  const uint32_t wantProgress = (elapsed * 144UL) / SPLASH_MS;
  if (wantProgress > lastBootProgress) {
    display.st7735_fill_rectangle(8 + lastBootProgress, 69,
                                   wantProgress - lastBootProgress, 3, GREEN);
    lastBootProgress = wantProgress;
  }
  return false;
}

inline uint16_t statusColor(const char *level) {
  if (level && strcmp(level, "LOW") == 0) return YELLOW;
  if (level && strcmp(level, "OK") == 0) return GREEN;
  if (level && (strcmp(level, "NO_VALID_RANGE") == 0 ||
                strcmp(level, "SENSOR_ERROR") == 0)) return RED;
  return GREY;
}
inline uint16_t statusBackground(const char *level) {
  if (level && strcmp(level, "LOW") == 0) return DEEP_YELLOW;
  if (level && strcmp(level, "OK") == 0) return DEEP_GREEN;
  if (level && (strcmp(level, "NO_VALID_RANGE") == 0 ||
                strcmp(level, "SENSOR_ERROR") == 0)) return DEEP_RED;
  return BLACK;
}
inline const char *shortLevel(const char *level) {
  if (!level) return "--";
  if (!strcmp(level, "NO_VALID_RANGE")) return "NO RANGE";
  if (!strcmp(level, "SENSOR_ERROR")) return "SENSOR ERR";
  if (!strcmp(level, "WAITING")) return "--";
  return level;
}

inline void resetCache() {
  cachedDistance = -32768;
  cachedLevel[0] = 0;
  cachedSeq = 0xFFFFFFFFUL;
  cachedRssi = cachedSnr = 32767;
  cachedLink = false;
  cachedFooterLink = false;
}
inline void header(bool tx) {
  if (!statusBase || statusIsTx != tx) {
    display.st7735_fill_screen(BLACK);
    display.st7735_write_str(4, 2, "NXTektal", Font_7x10, GREEN, BLACK);
    display.st7735_write_str(116, 2, tx ? "TX A01" : "RX A01",
                              Font_7x10, WHITE, BLACK);
    display.st7735_fill_rectangle(4, 15, 152, 1, DIM);
    statusIsTx = tx;
    statusBase = true;
    resetCache();
  }
}

inline void distanceRow(int distance, bool connected) {
  if (distance == cachedDistance && connected == cachedLink) return;
  display.st7735_fill_rectangle(4, 18, 152, 22, BLACK);
  char text[20];
  if (connected && distance > 0) snprintf(text, sizeof(text), "%d mm", distance);
  else snprintf(text, sizeof(text), connected ? "NO RANGE" : "WAITING");
  display.st7735_write_str(4, 19, text, Font_11x18, WHITE, BLACK);
  cachedDistance = distance;
  cachedLink = connected;
}

// Shared visual status logic for both TX and RX; LOW is always amber/yellow.
inline void levelRow(const char *level) {
  if (!level) level = "WAITING";
  if (!strcmp(level, cachedLevel)) return;
  const uint16_t bg = statusBackground(level);
  const uint16_t fg = statusColor(level);
  display.st7735_fill_rectangle(4, 43, 152, 16, bg);
  display.st7735_fill_rectangle(4, 43, 4, 16, fg);
  display.st7735_write_str(13, 46, "BALL", Font_7x10, WHITE, bg);
  display.st7735_write_str(55, 46, shortLevel(level),
                            Font_7x10, fg, bg);
  strncpy(cachedLevel, level, sizeof(cachedLevel) - 1);
  cachedLevel[sizeof(cachedLevel) - 1] = 0;
}

inline void txStatus(int distanceMM, const char *level,
                     unsigned long sequence, bool sensorReady) {
  header(true);
  const bool valid = sensorReady && distanceMM > 0;
  distanceRow(distanceMM, valid);
  levelRow(level);
  if (cachedSeq != sequence) {
    display.st7735_fill_rectangle(4, 63, 152, 15, BLACK);
    char text[32];
    snprintf(text, sizeof(text), "LoRa TX   #%lu", sequence);
    display.st7735_write_str(4, 66, text, Font_7x10, GREY, BLACK);
    cachedSeq = sequence;
  }
}

inline void rxStatus(int distanceMM, const char *level,
                     int rssi, int snr, unsigned long sequence, bool connected) {
  header(false);
  distanceRow(distanceMM, connected);
  levelRow(connected ? level : "WAITING");
  if (cachedSeq != sequence || cachedRssi != rssi ||
      cachedSnr != snr || cachedFooterLink != connected) {
    display.st7735_fill_rectangle(4, 63, 152, 15, BLACK);
    char text[32];
    if (connected) snprintf(text, sizeof(text), "R:%d S:%d #%lu", rssi, snr, sequence);
    else snprintf(text, sizeof(text), "LINK LOST");
    display.st7735_write_str(4, 66, text, Font_7x10,
                              connected ? GREY : RED, BLACK);
    cachedSeq = sequence;
    cachedRssi = rssi;
    cachedSnr = snr;
    cachedFooterLink = connected;
  }
}
} // namespace NXTUI
